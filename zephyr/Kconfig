## zephyr/Kconfig
```kconfig
# Copyright (c) 2024 Telink Semiconductor
# SPDX-License-Identifier: Apache-2.0

config LZMA
	bool "LZMA data compression and decompression"
	default y if SOC_RISCV_TELINK_B9X || SOC_RISCV_TELINK_TLX
	help
	  This option enables lzma compression & decompression library
	  support.
```
